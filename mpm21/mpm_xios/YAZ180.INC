
PUBLIC __YAZ180

PUBLIC __CPU_CLOCK

PUBLIC __IO_BASE_ADDRESS

PUBLIC __BIOS_SP
PUBLIC __BANK_SP

PUBLIC __COMMON_AREA_1_BASE
PUBLIC __COMMON_AREA_1_PHASE_DATA
PUBLIC __COMMON_AREA_1_PHASE_DRIVER

PUBLIC __ASCI0_RX_SIZE
PUBLIC __ASCI0_TX_SIZE

PUBLIC __ASCI1_RX_SIZE
PUBLIC __ASCI1_TX_SIZE

PUBLIC __IO_BREAK

PUBLIC __IO_PIO_PORT_BASE

PUBLIC __IO_PCA9665_1_PORT_BASE
PUBLIC __IO_PCA9665_2_PORT_BASE

PUBLIC __APU_CMD_SIZE
PUBLIC __APU_PTR_SIZE

PUBLIC __IO_APU_PORT_BASE




__YAZ180    EQU    1

__CPU_CLOCK    EQU    36864000

__IO_BASE_ADDRESS    EQU    0x0

__BIOS_SP    EQU    0xFFDE
__BANK_SP    EQU    0x003B

__COMMON_AREA_1_BASE    EQU    0xF000
__COMMON_AREA_1_PHASE_DATA    EQU    0xf000
__COMMON_AREA_1_PHASE_DRIVER    EQU    0xf580

__ASCI0_RX_SIZE    EQU    0x100
__ASCI0_TX_SIZE    EQU    0x080

__ASCI1_RX_SIZE    EQU    0x100
__ASCI1_TX_SIZE    EQU    0x080

__IO_BREAK    EQU    0x2000

__IO_PIO_PORT_BASE    EQU    0x4000

__IO_PCA9665_1_PORT_BASE    EQU    0xA000
__IO_PCA9665_2_PORT_BASE    EQU    0x8000

__APU_CMD_SIZE    EQU    0x100
__APU_PTR_SIZE    EQU    0x100

__IO_APU_PORT_BASE    EQU    0xC000









PUBLIC __Z180

PUBLIC __Z180_Z80180
PUBLIC __Z180_Z8L180
PUBLIC __Z180_Z8S180

PUBLIC __CPU_INFO

PUBLIC __CPU_INFO_ENABLE_SLL

PUBLIC __CPU_TIMER_SCALE


   ; Z8S180 / Z8L180 CLASS

   PUBLIC CNTLA0
   PUBLIC CNTLA1
   PUBLIC CNTLB0
   PUBLIC CNTLB1
   PUBLIC STAT0
   PUBLIC STAT1
   PUBLIC TDR0
   PUBLIC TDR1
   PUBLIC RDR0
   PUBLIC RDR1
   PUBLIC ASEXT0
   PUBLIC ASEXT1
   PUBLIC ASTC0L
   PUBLIC ASTC0H
   PUBLIC ASTC1L
   PUBLIC ASTC1H

   PUBLIC CNTR
   PUBLIC TRDR

   PUBLIC TMDR0L
   PUBLIC TMDR0H
   PUBLIC RLDR0L
   PUBLIC RLDR0H
   PUBLIC TCR
   PUBLIC TMDR1L
   PUBLIC TMDR1H
   PUBLIC RLDR1L
   PUBLIC RLDR1H

   PUBLIC FRC
   PUBLIC CMR
   PUBLIC CCR

   PUBLIC SAR0L
   PUBLIC SAR0H
   PUBLIC SAR0B
   PUBLIC DAR0L
   PUBLIC DAR0H
   PUBLIC DAR0B
   PUBLIC BCR0L
   PUBLIC BCR0H
   PUBLIC MAR1L
   PUBLIC MAR1H
   PUBLIC MAR1B
   PUBLIC IAR1L
   PUBLIC IAR1H
   PUBLIC IAR1B
   PUBLIC BCR1L
   PUBLIC BCR1H
   PUBLIC DSTAT
   PUBLIC DMODE
   PUBLIC DCNTL

   PUBLIC IL
   PUBLIC ITC

   PUBLIC RCR

   PUBLIC CBR
   PUBLIC BBR
   PUBLIC CBAR

   PUBLIC OMCR
   PUBLIC ICR
   
   ; I/O REGISTER BIT FIELDS

   PUBLIC CNTLA0_MPE
   PUBLIC CNTLA0_RE
   PUBLIC CNTLA0_TE
   PUBLIC CNTLA0_RTS0
   PUBLIC CNTLA0_MPBR
   PUBLIC CNTLA0_EFR
   PUBLIC CNTLA0_MODE_MASK
   PUBLIC CNTLA0_MODE_8P2
   PUBLIC CNTLA0_MODE_8P1
   PUBLIC CNTLA0_MODE_8N2
   PUBLIC CNTLA0_MODE_8N1
   PUBLIC CNTLA0_MODE_7P2
   PUBLIC CNTLA0_MODE_7P1
   PUBLIC CNTLA0_MODE_7N2
   PUBLIC CNTLA0_MODE_7N1

   PUBLIC CNTLA1_MPE
   PUBLIC CNTLA1_RE
   PUBLIC CNTLA1_TE
   PUBLIC CNTLA1_CKA1D
   PUBLIC CNTLA1_MPBR
   PUBLIC CNTLA1_EFR
   PUBLIC CNTLA1_MODE_MASK
   PUBLIC CNTLA1_MODE_8P2
   PUBLIC CNTLA1_MODE_8P1
   PUBLIC CNTLA1_MODE_8N2
   PUBLIC CNTLA1_MODE_8N1
   PUBLIC CNTLA1_MODE_7P2
   PUBLIC CNTLA1_MODE_7P1
   PUBLIC CNTLA1_MODE_7N2
   PUBLIC CNTLA1_MODE_7N1

   PUBLIC CNTLB0_MPBT
   PUBLIC CNTLB0_MP
   PUBLIC CNTLB0_CTS
   PUBLIC CNTLB0_PS
   PUBLIC CNTLB0_PEO
   PUBLIC CNTLB0_DR
   PUBLIC CNTLB0_SS_MASK
   PUBLIC CNTLB0_SS_EXT
   PUBLIC CNTLB0_SS_DIV_64
   PUBLIC CNTLB0_SS_DIV_32
   PUBLIC CNTLB0_SS_DIV_16
   PUBLIC CNTLB0_SS_DIV_8
   PUBLIC CNTLB0_SS_DIV_4
   PUBLIC CNTLB0_SS_DIV_2
   PUBLIC CNTLB0_SS_DIV_1

   PUBLIC CNTLB1_MPBT
   PUBLIC CNTLB1_MP
   PUBLIC CNTLB1_CTS
   PUBLIC CNTLB1_PS
   PUBLIC CNTLB1_PEO
   PUBLIC CNTLB1_DR
   PUBLIC CNTLB1_SS_MASK
   PUBLIC CNTLB1_SS_EXT
   PUBLIC CNTLB1_SS_DIV_64
   PUBLIC CNTLB1_SS_DIV_32
   PUBLIC CNTLB1_SS_DIV_16
   PUBLIC CNTLB1_SS_DIV_8
   PUBLIC CNTLB1_SS_DIV_4
   PUBLIC CNTLB1_SS_DIV_2
   PUBLIC CNTLB1_SS_DIV_1

   PUBLIC STAT0_RDRF
   PUBLIC STAT0_OVRN
   PUBLIC STAT0_PE
   PUBLIC STAT0_FE
   PUBLIC STAT0_RIE
   PUBLIC STAT0_DCD0
   PUBLIC STAT0_TDRE
   PUBLIC STAT0_TIE

   PUBLIC STAT1_RDRF
   PUBLIC STAT1_OVRN
   PUBLIC STAT1_PE
   PUBLIC STAT1_FE
   PUBLIC STAT1_RIE
   PUBLIC STAT1_CTS1E
   PUBLIC STAT1_TDRE
   PUBLIC STAT1_TIE

   PUBLIC CNTR_EF
   PUBLIC CNTR_EIE
   PUBLIC CNTR_RE
   PUBLIC CNTR_TE
   PUBLIC CNTR_SS_MASK
   PUBLIC CNTR_SS_EXT
   PUBLIC CNTR_SS_DIV_1280
   PUBLIC CNTR_SS_DIV_640
   PUBLIC CNTR_SS_DIV_320
   PUBLIC CNTR_SS_DIV_160
   PUBLIC CNTR_SS_DIV_80
   PUBLIC CNTR_SS_DIV_40
   PUBLIC CNTR_SS_DIV_20

   ; PRT REGISTER BIT FIELDS

   PUBLIC TCR_TIF1
   PUBLIC TCR_TIF0
   PUBLIC TCR_TIE1
   PUBLIC TCR_TIE0
   PUBLIC TCR_TOC1
   PUBLIC TCR_TOC0
   PUBLIC TCR_TDE1
   PUBLIC TCR_TDE0

   ; DMA REGISTER BIT FIELDS

   PUBLIC DCNTL_MWI1
   PUBLIC DCNTL_MWI0
   PUBLIC DCNTL_IWI1
   PUBLIC DCNTL_IWI0
   PUBLIC DCNTL_DMS1
   PUBLIC DCNTL_DMS0
   PUBLIC DCNTL_DIM1
   PUBLIC DCNTL_DIM0

   ; INT/TRAP CONTROL REGISTER (ITC) BIT FIELDS

   PUBLIC ITC_TRAP
   PUBLIC ITC_UFO
   PUBLIC ITC_ITE2
   PUBLIC ITC_ITE1
   PUBLIC ITC_ITE0

   ; Refresh CONTROL REGISTER (RCR) BIT FIELDS

   PUBLIC RCR_REFE
   PUBLIC RCR_REFW
   PUBLIC RCR_CYC1
   PUBLIC RCR_CYC0

   ; Operation Mode CONTROL REGISTER (OMCR) BIT FIELDS

   PUBLIC OMCR_M1E
   PUBLIC OMCR_M1TE
   PUBLIC OMCR_IOC

   ; CPU CLOCK MULTIPLIER REGISTER (CMR) BIT FIELDS (Z8S180 & higher Only)

   PUBLIC CMR_X2
   PUBLIC CMR_LN_XTAL

   ; CPU CONTROL REGISTER (CCR) BIT FIELDS (Z8S180 & higher Only)

   PUBLIC CCR_XTAL_X2
   PUBLIC CCR_STANDBY
   PUBLIC CCR_BREXT
   PUBLIC CCR_LNPHI
   PUBLIC CCR_IDLE
   PUBLIC CCR_LNIO
   PUBLIC CCR_LNCPUCTL
   PUBLIC CCR_LNAD





__Z180    EQU    0x04

__Z180_Z80180    EQU    0x01
__Z180_Z8L180    EQU    0x02
__Z180_Z8S180    EQU    0x04

__CPU_INFO    EQU    0x00

__CPU_INFO_ENABLE_SLL    EQU    0x01

__CPU_TIMER_SCALE    EQU    20


   ; Z8S180 / Z8L180 CLASS

CNTLA0    EQU    0x0
CNTLA1    EQU    0x1
CNTLB0    EQU    0x2
CNTLB1    EQU    0x3
STAT0    EQU    0x4
STAT1    EQU    0x5
TDR0    EQU    0x6
TDR1    EQU    0x7
RDR0    EQU    0x8
RDR1    EQU    0x9
ASEXT0    EQU    0x12
ASEXT1    EQU    0x13
ASTC0L    EQU    0x1a
ASTC0H    EQU    0x1b
ASTC1L    EQU    0x1c
ASTC1H    EQU    0x1d

CNTR    EQU    0xa
TRDR    EQU    0xb

TMDR0L    EQU    0xc
TMDR0H    EQU    0xd
RLDR0L    EQU    0xe
RLDR0H    EQU    0xf
TCR    EQU    0x10
TMDR1L    EQU    0x14
TMDR1H    EQU    0x15
RLDR1L    EQU    0x16
RLDR1H    EQU    0x17

FRC    EQU    0x18
CMR    EQU    0x1e
CCR    EQU    0x1f

SAR0L    EQU    0x20
SAR0H    EQU    0x21
SAR0B    EQU    0x22
DAR0L    EQU    0x23
DAR0H    EQU    0x24
DAR0B    EQU    0x25
BCR0L    EQU    0x26
BCR0H    EQU    0x27
MAR1L    EQU    0x28
MAR1H    EQU    0x29
MAR1B    EQU    0x2a
IAR1L    EQU    0x2b
IAR1H    EQU    0x2c
IAR1B    EQU    0x2d
BCR1L    EQU    0x2e
BCR1H    EQU    0x2f
DSTAT    EQU    0x30
DMODE    EQU    0x31
DCNTL    EQU    0x32

IL    EQU    0x33
ITC    EQU    0x34

RCR    EQU    0x36

CBR    EQU    0x38
BBR    EQU    0x39
CBAR    EQU    0x3a

OMCR    EQU    0x3e
ICR    EQU    0x3f

   ; I/O REGISTER BIT FIELDS

CNTLA0_MPE    EQU    0x80
CNTLA0_RE    EQU    0x40
CNTLA0_TE    EQU    0x20
CNTLA0_RTS0    EQU    0x10
CNTLA0_MPBR    EQU    0x08
CNTLA0_EFR    EQU    0x08
CNTLA0_MODE_MASK    EQU    0x07
CNTLA0_MODE_8P2    EQU    0x07
CNTLA0_MODE_8P1    EQU    0x06
CNTLA0_MODE_8N2    EQU    0x05
CNTLA0_MODE_8N1    EQU    0x04
CNTLA0_MODE_7P2    EQU    0x03
CNTLA0_MODE_7P1    EQU    0x02
CNTLA0_MODE_7N2    EQU    0x01
CNTLA0_MODE_7N1    EQU    0x00

CNTLA1_MPE    EQU    0x80
CNTLA1_RE    EQU    0x40
CNTLA1_TE    EQU    0x20
CNTLA1_CKA1D    EQU    0x10
CNTLA1_MPBR    EQU    0x08
CNTLA1_EFR    EQU    0x08
CNTLA1_MODE_MASK    EQU    0x07
CNTLA1_MODE_8P2    EQU    0x07
CNTLA1_MODE_8P1    EQU    0x06
CNTLA1_MODE_8N2    EQU    0x05
CNTLA1_MODE_8N1    EQU    0x04
CNTLA1_MODE_7P2    EQU    0x03
CNTLA1_MODE_7P1    EQU    0x02
CNTLA1_MODE_7N2    EQU    0x01
CNTLA1_MODE_7N1    EQU    0x00

CNTLB0_MPBT    EQU    0x80
CNTLB0_MP    EQU    0x40
CNTLB0_CTS    EQU    0x20
CNTLB0_PS    EQU    0x20
CNTLB0_PEO    EQU    0x10
CNTLB0_DR    EQU    0x08
CNTLB0_SS_MASK    EQU    0x07
CNTLB0_SS_EXT    EQU    0x07
CNTLB0_SS_DIV_64    EQU    0x06
CNTLB0_SS_DIV_32    EQU    0x05
CNTLB0_SS_DIV_16    EQU    0x04
CNTLB0_SS_DIV_8    EQU    0x03
CNTLB0_SS_DIV_4    EQU    0x02
CNTLB0_SS_DIV_2    EQU    0x01
CNTLB0_SS_DIV_1    EQU    0x00

CNTLB1_MPBT    EQU    0x80
CNTLB1_MP    EQU    0x40
CNTLB1_CTS    EQU    0x20
CNTLB1_PS    EQU    0x20
CNTLB1_PEO    EQU    0x10
CNTLB1_DR    EQU    0x08
CNTLB1_SS_MASK    EQU    0x07
CNTLB1_SS_EXT    EQU    0x07
CNTLB1_SS_DIV_64    EQU    0x06
CNTLB1_SS_DIV_32    EQU    0x05
CNTLB1_SS_DIV_16    EQU    0x04
CNTLB1_SS_DIV_8    EQU    0x03
CNTLB1_SS_DIV_4    EQU    0x02
CNTLB1_SS_DIV_2    EQU    0x01
CNTLB1_SS_DIV_1    EQU    0x00

STAT0_RDRF    EQU    0x80
STAT0_OVRN    EQU    0x40
STAT0_PE    EQU    0x20
STAT0_FE    EQU    0x10
STAT0_RIE    EQU    0x08
STAT0_DCD0    EQU    0x04
STAT0_TDRE    EQU    0x02
STAT0_TIE    EQU    0x01

STAT1_RDRF    EQU    0x80
STAT1_OVRN    EQU    0x40
STAT1_PE    EQU    0x20
STAT1_FE    EQU    0x10
STAT1_RIE    EQU    0x08
STAT1_CTS1E    EQU    0x04
STAT1_TDRE    EQU    0x02
STAT1_TIE    EQU    0x01

CNTR_EF    EQU    0x80
CNTR_EIE    EQU    0x40
CNTR_RE    EQU    0x20
CNTR_TE    EQU    0x10
CNTR_SS_MASK    EQU    0x07
CNTR_SS_EXT    EQU    0x07
CNTR_SS_DIV_1280    EQU    0x06
CNTR_SS_DIV_640    EQU    0x05
CNTR_SS_DIV_320    EQU    0x04
CNTR_SS_DIV_160    EQU    0x03
CNTR_SS_DIV_80    EQU    0x02
CNTR_SS_DIV_40    EQU    0x01
CNTR_SS_DIV_20    EQU    0x00

   ; PRT REGISTER BIT FIELDS

TCR_TIF1    EQU    0x80
TCR_TIF0    EQU    0x40
TCR_TIE1    EQU    0x20
TCR_TIE0    EQU    0x10
TCR_TOC1    EQU    0x08
TCR_TOC0    EQU    0x04
TCR_TDE1    EQU    0x02
TCR_TDE0    EQU    0x01

   ; DMA REGISTER BIT FIELDS

DSTAT_DE1    EQU    0x80
DSTAT_DE0    EQU    0x40
DSTAT_DWE1    EQU    0x20
DSTAT_DWE0    EQU    0x10
DSTAT_DIE1    EQU    0x08
DSTAT_DIE0    EQU    0x04
DSTAT_DME    EQU    0x01

DMODE_DM1    EQU    0x20
DMODE_DM0    EQU    0x10
DMODE_SM1    EQU    0x08
DMODE_SM0    EQU    0x04
DMODE_MMOD    EQU    0x02

DCNTL_MWI1    EQU    0x80
DCNTL_MWI0    EQU    0x40
DCNTL_IWI1    EQU    0x20
DCNTL_IWI0    EQU    0x10
DCNTL_DMS1    EQU    0x08
DCNTL_DMS0    EQU    0x04
DCNTL_DIM1    EQU    0x02
DCNTL_DIM0    EQU    0x01

   ; INT/TRAP CONTROL REGISTER (ITC) BIT FIELDS

ITC_TRAP    EQU    0x80
ITC_UFO    EQU    0x40
ITC_ITE2    EQU    0x04
ITC_ITE1    EQU    0x02
ITC_ITE0    EQU    0x01

   ; Refresh CONTROL REGISTER (RCR) BIT FIELDS

RCR_REFE    EQU    0x80
RCR_REFW    EQU    0x40
RCR_CYC1    EQU    0x02
RCR_CYC0    EQU    0x01

   ; Operation Mode CONTROL REGISTER (OMCR) BIT FIELDS

OMCR_M1E    EQU    0x80
OMCR_M1TE    EQU    0x40
OMCR_IOC    EQU    0x20

   ; CPU CLOCK MULTIPLIER REGISTER (CMR) BIT FIELDS (Z8S180 & higher Only)

CMR_X2    EQU    0x80
CMR_LN_XTAL    EQU    0x40

   ; CPU CONTROL REGISTER (CCR) BIT FIELDS (Z8S180 & higher Only)

CCR_XTAL_X2    EQU    0x80
CCR_STANDBY    EQU    0x40
CCR_BREXT    EQU    0x20
CCR_LNPHI    EQU    0x10
CCR_IDLE    EQU    0x08
CCR_LNIO    EQU    0x04
CCR_LNCPUCTL    EQU    0x02
CCR_LNAD    EQU    0x01










PUBLIC __CLIB_OPT_MULTITHREAD

PUBLIC __CLIB_OPT_MULTITHREAD_LOCK_HEAPS
PUBLIC __CLIB_OPT_MULTITHREAD_LOCK_FILES
PUBLIC __CLIB_OPT_MULTITHREAD_LOCK_FLIST
PUBLIC __CLIB_OPT_MULTITHREAD_LOCK_FDTBL
PUBLIC __CLIB_OPT_MULTITHREAD_LOCK_FDSTR

PUBLIC __CLIB_OPT_IMATH

PUBLIC __CLIB_OPT_IMATH_FAST

PUBLIC __CLIB_OPT_IMATH_FAST_DIV_UNROLL
PUBLIC __CLIB_OPT_IMATH_FAST_DIV_LZEROS
PUBLIC __CLIB_OPT_IMATH_FAST_MUL_UNROLL
PUBLIC __CLIB_OPT_IMATH_FAST_MUL_LZEROS
PUBLIC __CLIB_OPT_IMATH_FAST_LIA

PUBLIC __CLIB_OPT_IMATH_SELECT

PUBLIC __CLIB_OPT_IMATH_SELECT_FAST_ASR
PUBLIC __CLIB_OPT_IMATH_SELECT_FAST_LSR
PUBLIC __CLIB_OPT_IMATH_SELECT_FAST_LSL

PUBLIC __CLIB_OPT_TXT2NUM

PUBLIC __CLIB_OPT_TXT2NUM_INT_BIN
PUBLIC __CLIB_OPT_TXT2NUM_INT_OCT
PUBLIC __CLIB_OPT_TXT2NUM_INT_DEC
PUBLIC __CLIB_OPT_TXT2NUM_INT_HEX

PUBLIC __CLIB_OPT_TXT2NUM_LONG_BIN
PUBLIC __CLIB_OPT_TXT2NUM_LONG_OCT
PUBLIC __CLIB_OPT_TXT2NUM_LONG_DEC
PUBLIC __CLIB_OPT_TXT2NUM_LONG_HEX

PUBLIC __CLIB_OPT_TXT2NUM_SELECT

PUBLIC __CLIB_OPT_TXT2NUM_SELECT_FAST_BIN
PUBLIC __CLIB_OPT_TXT2NUM_SELECT_FAST_OCT
PUBLIC __CLIB_OPT_TXT2NUM_SELECT_FAST_DEC
PUBLIC __CLIB_OPT_TXT2NUM_SELECT_FAST_HEX

PUBLIC __CLIB_OPT_NUM2TXT

PUBLIC __CLIB_OPT_NUM2TXT_INT_BIN
PUBLIC __CLIB_OPT_NUM2TXT_INT_OCT
PUBLIC __CLIB_OPT_NUM2TXT_INT_DEC
PUBLIC __CLIB_OPT_NUM2TXT_INT_HEX

PUBLIC __CLIB_OPT_NUM2TXT_LONG_BIN
PUBLIC __CLIB_OPT_NUM2TXT_LONG_OCT
PUBLIC __CLIB_OPT_NUM2TXT_LONG_DEC
PUBLIC __CLIB_OPT_NUM2TXT_LONG_HEX

PUBLIC __CLIB_OPT_NUM2TXT_SELECT

PUBLIC __CLIB_OPT_NUM2TXT_SELECT_FAST_BIN
PUBLIC __CLIB_OPT_NUM2TXT_SELECT_FAST_OCT
PUBLIC __CLIB_OPT_NUM2TXT_SELECT_FAST_DEC
PUBLIC __CLIB_OPT_NUM2TXT_SELECT_FAST_HEX

PUBLIC __CLIB_OPT_STDIO

PUBLIC __CLIB_OPT_STDIO_VALID

PUBLIC CHAR_CR
PUBLIC CHAR_LF
PUBLIC CHAR_BS
PUBLIC CHAR_ESC
PUBLIC CHAR_CAPS
PUBLIC CHAR_BELL
PUBLIC CHAR_CTRL_C
PUBLIC CHAR_CTRL_D
PUBLIC CHAR_CTRL_Z
PUBLIC CHAR_CURSOR_UC
PUBLIC CHAR_CURSOR_LC
PUBLIC CHAR_PASSWORD

PUBLIC __CLIB_OPT_PRINTF

PUBLIC __CLIB_OPT_PRINTF_d
PUBLIC __CLIB_OPT_PRINTF_u
PUBLIC __CLIB_OPT_PRINTF_x
PUBLIC __CLIB_OPT_PRINTF_X
PUBLIC __CLIB_OPT_PRINTF_o
PUBLIC __CLIB_OPT_PRINTF_n
PUBLIC __CLIB_OPT_PRINTF_i
PUBLIC __CLIB_OPT_PRINTF_p
PUBLIC __CLIB_OPT_PRINTF_B
PUBLIC __CLIB_OPT_PRINTF_s
PUBLIC __CLIB_OPT_PRINTF_c
PUBLIC __CLIB_OPT_PRINTF_I
PUBLIC __CLIB_OPT_PRINTF_ld
PUBLIC __CLIB_OPT_PRINTF_lu
PUBLIC __CLIB_OPT_PRINTF_lx
PUBLIC __CLIB_OPT_PRINTF_lX
PUBLIC __CLIB_OPT_PRINTF_lo
PUBLIC __CLIB_OPT_PRINTF_ln
PUBLIC __CLIB_OPT_PRINTF_li
PUBLIC __CLIB_OPT_PRINTF_lp
PUBLIC __CLIB_OPT_PRINTF_lB
PUBLIC __CLIB_OPT_PRINTF_a
PUBLIC __CLIB_OPT_PRINTF_A
PUBLIC __CLIB_OPT_PRINTF_e
PUBLIC __CLIB_OPT_PRINTF_E
PUBLIC __CLIB_OPT_PRINTF_f
PUBLIC __CLIB_OPT_PRINTF_F
PUBLIC __CLIB_OPT_PRINTF_g
PUBLIC __CLIB_OPT_PRINTF_G

PUBLIC __CLIB_OPT_PRINTF_2

PUBLIC __CLIB_OPT_PRINTF_2_lld
PUBLIC __CLIB_OPT_PRINTF_2_llu
PUBLIC __CLIB_OPT_PRINTF_2_llx
PUBLIC __CLIB_OPT_PRINTF_2_llX
PUBLIC __CLIB_OPT_PRINTF_2_llo
PUBLIC __CLIB_OPT_PRINTF_2_lli

PUBLIC __CLIB_OPT_SCANF

PUBLIC __CLIB_OPT_SCANF_d
PUBLIC __CLIB_OPT_SCANF_u
PUBLIC __CLIB_OPT_SCANF_x
PUBLIC __CLIB_OPT_SCANF_X
PUBLIC __CLIB_OPT_SCANF_o
PUBLIC __CLIB_OPT_SCANF_n
PUBLIC __CLIB_OPT_SCANF_i
PUBLIC __CLIB_OPT_SCANF_p
PUBLIC __CLIB_OPT_SCANF_B
PUBLIC __CLIB_OPT_SCANF_s
PUBLIC __CLIB_OPT_SCANF_c
PUBLIC __CLIB_OPT_SCANF_I
PUBLIC __CLIB_OPT_SCANF_ld
PUBLIC __CLIB_OPT_SCANF_lu
PUBLIC __CLIB_OPT_SCANF_lx
PUBLIC __CLIB_OPT_SCANF_lX
PUBLIC __CLIB_OPT_SCANF_lo
PUBLIC __CLIB_OPT_SCANF_ln
PUBLIC __CLIB_OPT_SCANF_li
PUBLIC __CLIB_OPT_SCANF_lp
PUBLIC __CLIB_OPT_SCANF_lB
PUBLIC __CLIB_OPT_SCANF_BRACKET
PUBLIC __CLIB_OPT_SCANF_a
PUBLIC __CLIB_OPT_SCANF_A
PUBLIC __CLIB_OPT_SCANF_e
PUBLIC __CLIB_OPT_SCANF_E
PUBLIC __CLIB_OPT_SCANF_f
PUBLIC __CLIB_OPT_SCANF_F
PUBLIC __CLIB_OPT_SCANF_g
PUBLIC __CLIB_OPT_SCANF_G

PUBLIC __CLIB_OPT_SCANF_2

PUBLIC __CLIB_OPT_SCANF_2_lld
PUBLIC __CLIB_OPT_SCANF_2_llu
PUBLIC __CLIB_OPT_SCANF_2_llx
PUBLIC __CLIB_OPT_SCANF_2_llX
PUBLIC __CLIB_OPT_SCANF_2_llo
PUBLIC __CLIB_OPT_SCANF_2_lli

PUBLIC __CLIB_OPT_UNROLL

PUBLIC __CLIB_OPT_UNROLL_MEMCPY
PUBLIC __CLIB_OPT_UNROLL_MEMSET
PUBLIC __CLIB_OPT_UNROLL_OTIR
PUBLIC __CLIB_OPT_UNROLL_LDIR
PUBLIC __CLIB_OPT_UNROLL_USER_SMC
PUBLIC __CLIB_OPT_UNROLL_LIB_SMC

PUBLIC __CLIB_OPT_STRTOD

PUBLIC __CLIB_OPT_STRTOD_NAN
PUBLIC __CLIB_OPT_STRTOD_INF
PUBLIC __CLIB_OPT_STRTOD_HEX

PUBLIC __CLIB_OPT_SORT

PUBLIC __CLIB_OPT_SORT_INSERTION
PUBLIC __CLIB_OPT_SORT_SHELL
PUBLIC __CLIB_OPT_SORT_QUICK

PUBLIC __CLIB_OPT_SORT_QSORT

PUBLIC __CLIB_OPT_SORT_QSORT_PIVOT
PUBLIC __CLIB_OPT_SORT_QSORT_PIVOT_MID
PUBLIC __CLIB_OPT_SORT_QSORT_PIVOT_RAN
PUBLIC __CLIB_OPT_SORT_QSORT_ENABLE_INSERTION
PUBLIC __CLIB_OPT_SORT_QSORT_ENABLE_EQUAL

PUBLIC __CLIB_OPT_ERROR

PUBLIC __CLIB_OPT_ERROR_ENABLED
PUBLIC __CLIB_OPT_ERROR_VERBOSE




__CLIB_OPT_MULTITHREAD    EQU    0x00

__CLIB_OPT_MULTITHREAD_LOCK_HEAPS    EQU    0x01
__CLIB_OPT_MULTITHREAD_LOCK_FILES    EQU    0x02
__CLIB_OPT_MULTITHREAD_LOCK_FLIST    EQU    0x04
__CLIB_OPT_MULTITHREAD_LOCK_FDTBL    EQU    0x08
__CLIB_OPT_MULTITHREAD_LOCK_FDSTR    EQU    0x10

__CLIB_OPT_IMATH    EQU    0

__CLIB_OPT_IMATH_FAST    EQU    0x0f

__CLIB_OPT_IMATH_FAST_DIV_UNROLL    EQU    0x01
__CLIB_OPT_IMATH_FAST_DIV_LZEROS    EQU    0x02
__CLIB_OPT_IMATH_FAST_MUL_UNROLL    EQU    0x04
__CLIB_OPT_IMATH_FAST_MUL_LZEROS    EQU    0x08
__CLIB_OPT_IMATH_FAST_LIA    EQU    0x80

__CLIB_OPT_IMATH_SELECT    EQU    0x00

__CLIB_OPT_IMATH_SELECT_FAST_ASR    EQU    0x01
__CLIB_OPT_IMATH_SELECT_FAST_LSR    EQU    0x02
__CLIB_OPT_IMATH_SELECT_FAST_LSL    EQU    0x04

__CLIB_OPT_TXT2NUM    EQU    0x04

__CLIB_OPT_TXT2NUM_INT_BIN    EQU    0x01
__CLIB_OPT_TXT2NUM_INT_OCT    EQU    0x02
__CLIB_OPT_TXT2NUM_INT_DEC    EQU    0x04
__CLIB_OPT_TXT2NUM_INT_HEX    EQU    0x08

__CLIB_OPT_TXT2NUM_LONG_BIN    EQU    0x10
__CLIB_OPT_TXT2NUM_LONG_OCT    EQU    0x20
__CLIB_OPT_TXT2NUM_LONG_DEC    EQU    0x40
__CLIB_OPT_TXT2NUM_LONG_HEX    EQU    0x80

__CLIB_OPT_TXT2NUM_SELECT    EQU    0x00

__CLIB_OPT_TXT2NUM_SELECT_FAST_BIN    EQU    0x01
__CLIB_OPT_TXT2NUM_SELECT_FAST_OCT    EQU    0x02
__CLIB_OPT_TXT2NUM_SELECT_FAST_DEC    EQU    0x04
__CLIB_OPT_TXT2NUM_SELECT_FAST_HEX    EQU    0x08

__CLIB_OPT_NUM2TXT    EQU    0x00

__CLIB_OPT_NUM2TXT_INT_BIN    EQU    0x01
__CLIB_OPT_NUM2TXT_INT_OCT    EQU    0x02
__CLIB_OPT_NUM2TXT_INT_DEC    EQU    0x04
__CLIB_OPT_NUM2TXT_INT_HEX    EQU    0x08

__CLIB_OPT_NUM2TXT_LONG_BIN    EQU    0x10
__CLIB_OPT_NUM2TXT_LONG_OCT    EQU    0x20
__CLIB_OPT_NUM2TXT_LONG_DEC    EQU    0x40
__CLIB_OPT_NUM2TXT_LONG_HEX    EQU    0x80

__CLIB_OPT_NUM2TXT_SELECT    EQU    0x00

__CLIB_OPT_NUM2TXT_SELECT_FAST_BIN    EQU    0x01
__CLIB_OPT_NUM2TXT_SELECT_FAST_OCT    EQU    0x02
__CLIB_OPT_NUM2TXT_SELECT_FAST_DEC    EQU    0x04
__CLIB_OPT_NUM2TXT_SELECT_FAST_HEX    EQU    0x08

__CLIB_OPT_STDIO    EQU    0x00

__CLIB_OPT_STDIO_VALID    EQU    0x01

CHAR_CR    EQU    13
CHAR_LF    EQU    10
CHAR_BS    EQU    8
CHAR_ESC    EQU    27
CHAR_CAPS    EQU    6
CHAR_BELL    EQU    7
CHAR_CTRL_C    EQU    3
CHAR_CTRL_D    EQU    4
CHAR_CTRL_Z    EQU    26
CHAR_CURSOR_UC    EQU    45
CHAR_CURSOR_LC    EQU    95
CHAR_PASSWORD    EQU    42

__CLIB_OPT_PRINTF    EQU    0x002ff6ff

__CLIB_OPT_PRINTF_d    EQU    0x00000001
__CLIB_OPT_PRINTF_u    EQU    0x00000002
__CLIB_OPT_PRINTF_x    EQU    0x00000004
__CLIB_OPT_PRINTF_X    EQU    0x00000008
__CLIB_OPT_PRINTF_o    EQU    0x00000010
__CLIB_OPT_PRINTF_n    EQU    0x00000020
__CLIB_OPT_PRINTF_i    EQU    0x00000040
__CLIB_OPT_PRINTF_p    EQU    0x00000080
__CLIB_OPT_PRINTF_B    EQU    0x00000100
__CLIB_OPT_PRINTF_s    EQU    0x00000200
__CLIB_OPT_PRINTF_c    EQU    0x00000400
__CLIB_OPT_PRINTF_I    EQU    0x00000800
__CLIB_OPT_PRINTF_ld    EQU    0x00001000
__CLIB_OPT_PRINTF_lu    EQU    0x00002000
__CLIB_OPT_PRINTF_lx    EQU    0x00004000
__CLIB_OPT_PRINTF_lX    EQU    0x00008000
__CLIB_OPT_PRINTF_lo    EQU    0x00010000
__CLIB_OPT_PRINTF_ln    EQU    0x00020000
__CLIB_OPT_PRINTF_li    EQU    0x00040000
__CLIB_OPT_PRINTF_lp    EQU    0x00080000
__CLIB_OPT_PRINTF_lB    EQU    0x00100000
__CLIB_OPT_PRINTF_a    EQU    0x00400000
__CLIB_OPT_PRINTF_A    EQU    0x00800000
__CLIB_OPT_PRINTF_e    EQU    0x01000000
__CLIB_OPT_PRINTF_E    EQU    0x02000000
__CLIB_OPT_PRINTF_f    EQU    0x04000000
__CLIB_OPT_PRINTF_F    EQU    0x08000000
__CLIB_OPT_PRINTF_g    EQU    0x10000000
__CLIB_OPT_PRINTF_G    EQU    0x20000000

__CLIB_OPT_PRINTF_2    EQU    0x00

__CLIB_OPT_PRINTF_2_lld    EQU    0x01
__CLIB_OPT_PRINTF_2_llu    EQU    0x02
__CLIB_OPT_PRINTF_2_llx    EQU    0x04
__CLIB_OPT_PRINTF_2_llX    EQU    0x08
__CLIB_OPT_PRINTF_2_llo    EQU    0x10
__CLIB_OPT_PRINTF_2_lli    EQU    0x40

__CLIB_OPT_SCANF    EQU    0x002ff6ff

__CLIB_OPT_SCANF_d    EQU    0x00000001
__CLIB_OPT_SCANF_u    EQU    0x00000002
__CLIB_OPT_SCANF_x    EQU    0x00000004
__CLIB_OPT_SCANF_X    EQU    0x00000008
__CLIB_OPT_SCANF_o    EQU    0x00000010
__CLIB_OPT_SCANF_n    EQU    0x00000020
__CLIB_OPT_SCANF_i    EQU    0x00000040
__CLIB_OPT_SCANF_p    EQU    0x00000080
__CLIB_OPT_SCANF_B    EQU    0x00000100
__CLIB_OPT_SCANF_s    EQU    0x00000200
__CLIB_OPT_SCANF_c    EQU    0x00000400
__CLIB_OPT_SCANF_I    EQU    0x00000800
__CLIB_OPT_SCANF_ld    EQU    0x00001000
__CLIB_OPT_SCANF_lu    EQU    0x00002000
__CLIB_OPT_SCANF_lx    EQU    0x00004000
__CLIB_OPT_SCANF_lX    EQU    0x00008000
__CLIB_OPT_SCANF_lo    EQU    0x00010000
__CLIB_OPT_SCANF_ln    EQU    0x00020000
__CLIB_OPT_SCANF_li    EQU    0x00040000
__CLIB_OPT_SCANF_lp    EQU    0x00080000
__CLIB_OPT_SCANF_lB    EQU    0x00100000
__CLIB_OPT_SCANF_BRACKET    EQU    0x00200000
__CLIB_OPT_SCANF_a    EQU    0x00400000
__CLIB_OPT_SCANF_A    EQU    0x00800000
__CLIB_OPT_SCANF_e    EQU    0x01000000
__CLIB_OPT_SCANF_E    EQU    0x02000000
__CLIB_OPT_SCANF_f    EQU    0x04000000
__CLIB_OPT_SCANF_F    EQU    0x08000000
__CLIB_OPT_SCANF_g    EQU    0x10000000
__CLIB_OPT_SCANF_G    EQU    0x20000000

__CLIB_OPT_SCANF_2    EQU    0x00

__CLIB_OPT_SCANF_2_lld    EQU    0x01
__CLIB_OPT_SCANF_2_llu    EQU    0x02
__CLIB_OPT_SCANF_2_llx    EQU    0x04
__CLIB_OPT_SCANF_2_llX    EQU    0x08
__CLIB_OPT_SCANF_2_llo    EQU    0x10
__CLIB_OPT_SCANF_2_lli    EQU    0x40

__CLIB_OPT_UNROLL    EQU    0x00

__CLIB_OPT_UNROLL_MEMCPY    EQU    0x01
__CLIB_OPT_UNROLL_MEMSET    EQU    0x02
__CLIB_OPT_UNROLL_OTIR    EQU    0x10
__CLIB_OPT_UNROLL_LDIR    EQU    0x20
__CLIB_OPT_UNROLL_USER_SMC    EQU    0x40
__CLIB_OPT_UNROLL_LIB_SMC    EQU    0x80

__CLIB_OPT_STRTOD    EQU    0x00

__CLIB_OPT_STRTOD_NAN    EQU    0x01
__CLIB_OPT_STRTOD_INF    EQU    0x01
__CLIB_OPT_STRTOD_HEX    EQU    0x02

__CLIB_OPT_SORT    EQU    1

__CLIB_OPT_SORT_INSERTION    EQU    0
__CLIB_OPT_SORT_SHELL    EQU    1
__CLIB_OPT_SORT_QUICK    EQU    2

__CLIB_OPT_SORT_QSORT    EQU    0x0c

__CLIB_OPT_SORT_QSORT_PIVOT    EQU    0x3
__CLIB_OPT_SORT_QSORT_PIVOT_MID    EQU    0x0
__CLIB_OPT_SORT_QSORT_PIVOT_RAN    EQU    0x1
__CLIB_OPT_SORT_QSORT_ENABLE_INSERTION    EQU    0x04
__CLIB_OPT_SORT_QSORT_ENABLE_EQUAL    EQU    0x08

__CLIB_OPT_ERROR    EQU    0x00

__CLIB_OPT_ERROR_ENABLED    EQU    0x01
__CLIB_OPT_ERROR_VERBOSE    EQU    0x02













PUBLIC __EOK
PUBLIC __EACCES
PUBLIC __EBADF
PUBLIC __EBDFD
PUBLIC __EDOM
PUBLIC __EFBIG
PUBLIC __EINVAL
PUBLIC __EIO
PUBLIC __EMFILE
PUBLIC __ENFILE
PUBLIC __ENOLCK
PUBLIC __ENOMEM
PUBLIC __ENOTSUP
PUBLIC __EOVERFLOW
PUBLIC __ERANGE
PUBLIC __ESTAT
PUBLIC __EAGAIN
PUBLIC __EWOULDBLOCK

PUBLIC __ERROR_NEXT

PUBLIC STDIO_SEEK_SET
PUBLIC STDIO_SEEK_CUR
PUBLIC STDIO_SEEK_END

PUBLIC STDIO_MSG_PUTC
PUBLIC STDIO_MSG_WRIT
PUBLIC STDIO_MSG_GETC
PUBLIC STDIO_MSG_EATC
PUBLIC STDIO_MSG_READ
PUBLIC STDIO_MSG_SEEK
PUBLIC STDIO_MSG_ICTL
PUBLIC STDIO_MSG_FLSH
PUBLIC STDIO_MSG_CLOS

PUBLIC ITERM_MSG_GETC
PUBLIC ITERM_MSG_REJECT
PUBLIC ITERM_MSG_INTERRUPT
PUBLIC ITERM_MSG_PUTC
PUBLIC ITERM_MSG_PRINT_CURSOR
PUBLIC ITERM_MSG_ERASE_CURSOR
PUBLIC ITERM_MSG_ERASE_CURSOR_PWD
PUBLIC ITERM_MSG_BS
PUBLIC ITERM_MSG_BS_PWD
PUBLIC ITERM_MSG_READLINE_BEGIN
PUBLIC ITERM_MSG_READLINE_END
PUBLIC ITERM_MSG_READLINE_SCROLL_LIMIT
PUBLIC ITERM_MSG_BELL
      
PUBLIC __MESSAGE_ITERM_NEXT__

PUBLIC OTERM_MSG_PUTC
PUBLIC OTERM_MSG_TTY
PUBLIC OTERM_MSG_FZX_PUTC
PUBLIC OTERM_MSG_PRINTC
PUBLIC OTERM_MSG_SCROLL
PUBLIC OTERM_MSG_SCROLL_LIMIT
PUBLIC OTERM_MSG_CLS
PUBLIC OTERM_MSG_PAUSE
PUBLIC OTERM_MSG_BELL
PUBLIC OTERM_MSG_PSCROLL
PUBLIC OTERM_MSG_FZX_GET_XOR_DRAW
      
PUBLIC __MESSAGE_OTERM_NEXT__

PUBLIC ICHAR_MSG_GETC
PUBLIC OCHAR_MSG_PUTC_BIN
PUBLIC OCHAR_MSG_PUTC
  
PUBLIC __MESSAGE_NEXT__

PUBLIC mtx_plain
PUBLIC mtx_recursive
PUBLIC mtx_timed

PUBLIC thrd_success
PUBLIC thrd_error
PUBLIC thrd_nomem
PUBLIC thrd_busy
PUBLIC thrd_timedout

PUBLIC IOCTL_RESET

PUBLIC IOCTL_ITERM_ECHO
PUBLIC IOCTL_ITERM_PASS
PUBLIC IOCTL_ITERM_LINE
PUBLIC IOCTL_ITERM_COOK
PUBLIC IOCTL_ITERM_CAPS
PUBLIC IOCTL_ITERM_CRLF
PUBLIC IOCTL_ITERM_CURS
   
PUBLIC IOCTL_ITERM_TIE
PUBLIC IOCTL_ITERM_GET_EDITBUF
PUBLIC IOCTL_ITERM_SET_EDITBUF

PUBLIC IOCTL_OTERM_PAGE
PUBLIC IOCTL_OTERM_PAUSE
PUBLIC IOCTL_OTERM_COOK
PUBLIC IOCTL_OTERM_CRLF
PUBLIC IOCTL_OTERM_CLEAR
PUBLIC IOCTL_OTERM_SIGNAL
PUBLIC IOCTL_OTERM_BELL

PUBLIC IOCTL_OTERM_CLS
PUBLIC IOCTL_OTERM_RESET_SCROLL
PUBLIC IOCTL_OTERM_GET_WINDOW_COORD
PUBLIC IOCTL_OTERM_SET_WINDOW_COORD
PUBLIC IOCTL_OTERM_GET_WINDOW_RECT
PUBLIC IOCTL_OTERM_SET_WINDOW_RECT
PUBLIC IOCTL_OTERM_GET_CURSOR_COORD
PUBLIC IOCTL_OTERM_SET_CURSOR_COORD
PUBLIC IOCTL_OTERM_GET_OTERM
PUBLIC IOCTL_OTERM_SCROLL
PUBLIC IOCTL_OTERM_FONT
PUBLIC IOCTL_OTERM_SCROLL_LIMIT

PUBLIC IOCTL_OTERM_FZX_GET_PAPER_COORD
PUBLIC IOCTL_OTERM_FZX_SET_PAPER_COORD
PUBLIC IOCTL_OTERM_FZX_GET_PAPER_RECT
PUBLIC IOCTL_OTERM_FZX_SET_PAPER_RECT
PUBLIC IOCTL_OTERM_FZX_LEFT_MARGIN
PUBLIC IOCTL_OTERM_FZX_LINE_SPACING
PUBLIC IOCTL_OTERM_FZX_SPACE_EXPAND
PUBLIC IOCTL_OTERM_FZX_GET_FZX_STATE
PUBLIC IOCTL_OTERM_FZX_SET_FZX_STATE

PUBLIC IOCTL_ICHAR_CRLF
   
PUBLIC IOCTL_OCHAR_CRLF




__EOK    EQU    0
__EACCES    EQU    1
__EBADF    EQU    2
__EBDFD    EQU    3
__EDOM    EQU    4
__EFBIG    EQU    5
__EINVAL    EQU    6
__EIO    EQU    7
__EMFILE    EQU    8
__ENFILE    EQU    9
__ENOLCK    EQU    10
__ENOMEM    EQU    11
__ENOTSUP    EQU    12
__EOVERFLOW    EQU    13
__ERANGE    EQU    14
__ESTAT    EQU    15
__EAGAIN    EQU    16
__EWOULDBLOCK    EQU    16

__ERROR_NEXT    EQU    50

STDIO_SEEK_SET    EQU    0
STDIO_SEEK_CUR    EQU    1
STDIO_SEEK_END    EQU    2

STDIO_MSG_PUTC    EQU    1
STDIO_MSG_WRIT    EQU    2
STDIO_MSG_GETC    EQU    3
STDIO_MSG_EATC    EQU    4
STDIO_MSG_READ    EQU    5
STDIO_MSG_SEEK    EQU    6
STDIO_MSG_ICTL    EQU    7
STDIO_MSG_FLSH    EQU    8
STDIO_MSG_CLOS    EQU    9

ITERM_MSG_GETC    EQU    15
ITERM_MSG_REJECT    EQU    16
ITERM_MSG_INTERRUPT    EQU    17
ITERM_MSG_PUTC    EQU    18
ITERM_MSG_PRINT_CURSOR    EQU    19
ITERM_MSG_ERASE_CURSOR    EQU    20
ITERM_MSG_ERASE_CURSOR_PWD    EQU    21
ITERM_MSG_BS    EQU    22
ITERM_MSG_BS_PWD    EQU    23
ITERM_MSG_READLINE_BEGIN    EQU    24
ITERM_MSG_READLINE_END    EQU    25
ITERM_MSG_READLINE_SCROLL_LIMIT    EQU    26
ITERM_MSG_BELL    EQU    27
      
__MESSAGE_ITERM_NEXT__    EQU    28

OTERM_MSG_PUTC    EQU    30
OTERM_MSG_TTY    EQU    31
OTERM_MSG_FZX_PUTC    EQU    32
OTERM_MSG_PRINTC    EQU    33
OTERM_MSG_SCROLL    EQU    34
OTERM_MSG_SCROLL_LIMIT    EQU    35
OTERM_MSG_CLS    EQU    36
OTERM_MSG_PAUSE    EQU    37
OTERM_MSG_BELL    EQU    38
OTERM_MSG_PSCROLL    EQU    39
OTERM_MSG_FZX_GET_XOR_DRAW    EQU    40
      
__MESSAGE_OTERM_NEXT__    EQU    41

ICHAR_MSG_GETC    EQU    15
OCHAR_MSG_PUTC_BIN    EQU    30
OCHAR_MSG_PUTC    EQU    33
  
__MESSAGE_NEXT__    EQU    45

mtx_plain    EQU    0x01
mtx_recursive    EQU    0x02
mtx_timed    EQU    0x04

thrd_success    EQU    0x00
thrd_error    EQU    0x01
thrd_nomem    EQU    0x02
thrd_busy    EQU    0x04
thrd_timedout    EQU    0x08

IOCTL_RESET    EQU    0x0000

IOCTL_ITERM_ECHO    EQU    0xc081
IOCTL_ITERM_PASS    EQU    0xc041
IOCTL_ITERM_LINE    EQU    0xc021
IOCTL_ITERM_COOK    EQU    0xc011
IOCTL_ITERM_CAPS    EQU    0xc009
IOCTL_ITERM_CRLF    EQU    0xc101
IOCTL_ITERM_CURS    EQU    0xc201
   
IOCTL_ITERM_TIE    EQU    0x0201
IOCTL_ITERM_GET_EDITBUF    EQU    0x0381
IOCTL_ITERM_SET_EDITBUF    EQU    0x0301

IOCTL_OTERM_PAGE    EQU    0xc082
IOCTL_OTERM_PAUSE    EQU    0xc042
IOCTL_OTERM_COOK    EQU    0xc022
IOCTL_OTERM_CRLF    EQU    0xc012
IOCTL_OTERM_CLEAR    EQU    0xe002
IOCTL_OTERM_SIGNAL    EQU    0xc202
IOCTL_OTERM_BELL    EQU    0xc102

IOCTL_OTERM_CLS    EQU    0x0102
IOCTL_OTERM_RESET_SCROLL    EQU    0x0202
IOCTL_OTERM_GET_WINDOW_COORD    EQU    0x0382
IOCTL_OTERM_SET_WINDOW_COORD    EQU    0x0302
IOCTL_OTERM_GET_WINDOW_RECT    EQU    0x0482
IOCTL_OTERM_SET_WINDOW_RECT    EQU    0x0402
IOCTL_OTERM_GET_CURSOR_COORD    EQU    0x0582
IOCTL_OTERM_SET_CURSOR_COORD    EQU    0x0502
IOCTL_OTERM_GET_OTERM    EQU    0x0602
IOCTL_OTERM_SCROLL    EQU    0x0702
IOCTL_OTERM_FONT    EQU    0x0802
IOCTL_OTERM_SCROLL_LIMIT    EQU    0x0902

IOCTL_OTERM_FZX_GET_PAPER_COORD    EQU    0x0a82
IOCTL_OTERM_FZX_SET_PAPER_COORD    EQU    0x0a02
IOCTL_OTERM_FZX_GET_PAPER_RECT    EQU    0x0b82
IOCTL_OTERM_FZX_SET_PAPER_RECT    EQU    0x0b02
IOCTL_OTERM_FZX_LEFT_MARGIN    EQU    0x0c02
IOCTL_OTERM_FZX_LINE_SPACING    EQU    0x0d02
IOCTL_OTERM_FZX_SPACE_EXPAND    EQU    0x0e02
IOCTL_OTERM_FZX_GET_FZX_STATE    EQU    0x0f82
IOCTL_OTERM_FZX_SET_FZX_STATE    EQU    0x0f02

IOCTL_ICHAR_CRLF    EQU    0xc103
   
IOCTL_OCHAR_CRLF    EQU    0xc014




























PUBLIC __IO_PIO_PORT_A
PUBLIC __IO_PIO_PORT_B
PUBLIC __IO_PIO_PORT_C
PUBLIC __IO_PIO_CONTROL

PUBLIC __IO_PIO_CNTL_00
PUBLIC __IO_PIO_CNTL_01
PUBLIC __IO_PIO_CNTL_02
PUBLIC __IO_PIO_CNTL_03

PUBLIC __IO_PIO_CNTL_04
PUBLIC __IO_PIO_CNTL_05
PUBLIC __IO_PIO_CNTL_06
PUBLIC __IO_PIO_CNTL_07

PUBLIC __IO_PIO_CNTL_08
PUBLIC __IO_PIO_CNTL_09
PUBLIC __IO_PIO_CNTL_10
PUBLIC __IO_PIO_CNTL_11

PUBLIC __IO_PIO_CNTL_12
PUBLIC __IO_PIO_CNTL_13
PUBLIC __IO_PIO_CNTL_14
PUBLIC __IO_PIO_CNTL_15




__IO_PIO_PORT_A    EQU    0x4000
__IO_PIO_PORT_B    EQU    0x4001
__IO_PIO_PORT_C    EQU    0x4002
__IO_PIO_CONTROL    EQU    0x4003

__IO_PIO_CNTL_00    EQU    0x80
__IO_PIO_CNTL_01    EQU    0x81
__IO_PIO_CNTL_02    EQU    0x82
__IO_PIO_CNTL_03    EQU    0x83

__IO_PIO_CNTL_04    EQU    0x88
__IO_PIO_CNTL_05    EQU    0x89
__IO_PIO_CNTL_06    EQU    0x8A
__IO_PIO_CNTL_07    EQU    0x8B

__IO_PIO_CNTL_08    EQU    0x90
__IO_PIO_CNTL_09    EQU    0x91
__IO_PIO_CNTL_10    EQU    0x92
__IO_PIO_CNTL_11    EQU    0x83

__IO_PIO_CNTL_12    EQU    0x98
__IO_PIO_CNTL_13    EQU    0x99
__IO_PIO_CNTL_14    EQU    0x9A
__IO_PIO_CNTL_15    EQU    0x9B









PUBLIC __IO_APU_DATA
PUBLIC __IO_APU_CONTROL
PUBLIC __IO_APU_STATUS

PUBLIC __IO_APU_STATUS_BUSY
PUBLIC __IO_APU_STATUS_SIGN
PUBLIC __IO_APU_STATUS_ZERO
PUBLIC __IO_APU_STATUS_DIV0
PUBLIC __IO_APU_STATUS_NEGRT
PUBLIC __IO_APU_STATUS_UNDFL
PUBLIC __IO_APU_STATUS_OVRFL
PUBLIC __IO_APU_STATUS_CARRY

PUBLIC __IO_APU_STATUS_ERROR

PUBLIC __IO_APU_COMMAND_SVREQ

PUBLIC __IO_APU_OP_ENT
PUBLIC __IO_APU_OP_REM
PUBLIC __IO_APU_OP_ENT16
PUBLIC __IO_APU_OP_ENT32
PUBLIC __IO_APU_OP_REM16
PUBLIC __IO_APU_OP_REM32

PUBLIC __IO_APU_OP_SADD
PUBLIC __IO_APU_OP_SSUB
PUBLIC __IO_APU_OP_SMUL
PUBLIC __IO_APU_OP_SMUU
PUBLIC __IO_APU_OP_SDIV

PUBLIC __IO_APU_OP_DADD
PUBLIC __IO_APU_OP_DSUB
PUBLIC __IO_APU_OP_DMUL
PUBLIC __IO_APU_OP_DMUU
PUBLIC __IO_APU_OP_DDIV

PUBLIC __IO_APU_OP_FADD
PUBLIC __IO_APU_OP_FSUB
PUBLIC __IO_APU_OP_FMUL
PUBLIC __IO_APU_OP_FDIV

PUBLIC __IO_APU_OP_SQRT
PUBLIC __IO_APU_OP_SIN
PUBLIC __IO_APU_OP_COS
PUBLIC __IO_APU_OP_TAN
PUBLIC __IO_APU_OP_ASIN
PUBLIC __IO_APU_OP_ACOS
PUBLIC __IO_APU_OP_ATAN
PUBLIC __IO_APU_OP_LOG
PUBLIC __IO_APU_OP_LN
PUBLIC __IO_APU_OP_EXP
PUBLIC __IO_APU_OP_PWR

PUBLIC __IO_APU_OP_NOP
PUBLIC __IO_APU_OP_FIXS
PUBLIC __IO_APU_OP_FIXD
PUBLIC __IO_APU_OP_FLTS
PUBLIC __IO_APU_OP_FLTD
PUBLIC __IO_APU_OP_CHSS
PUBLIC __IO_APU_OP_CHSD
PUBLIC __IO_APU_OP_CHSF
PUBLIC __IO_APU_OP_PTOS
PUBLIC __IO_APU_OP_PTOD
PUBLIC __IO_APU_OP_PTOF
PUBLIC __IO_APU_OP_POPS
PUBLIC __IO_APU_OP_POPD
PUBLIC __IO_APU_OP_POPF
PUBLIC __IO_APU_OP_XCHS
PUBLIC __IO_APU_OP_XCHD
PUBLIC __IO_APU_OP_XCHF
PUBLIC __IO_APU_OP_PUPI




__IO_APU_DATA    EQU    0xc000
__IO_APU_CONTROL    EQU    0xc001
__IO_APU_STATUS    EQU    0xc001

__IO_APU_STATUS_BUSY    EQU    0x80
__IO_APU_STATUS_SIGN    EQU    0x40
__IO_APU_STATUS_ZERO    EQU    0x20
__IO_APU_STATUS_DIV0    EQU    0x10
__IO_APU_STATUS_NEGRT    EQU    0x08
__IO_APU_STATUS_UNDFL    EQU    0x04
__IO_APU_STATUS_OVRFL    EQU    0x02
__IO_APU_STATUS_CARRY    EQU    0x01

__IO_APU_STATUS_ERROR    EQU    0x1E

__IO_APU_COMMAND_SVREQ    EQU    0x80

__IO_APU_OP_ENT    EQU    0x40
__IO_APU_OP_REM    EQU    0x50
__IO_APU_OP_ENT16    EQU    0x40
__IO_APU_OP_ENT32    EQU    0x41
__IO_APU_OP_REM16    EQU    0x50
__IO_APU_OP_REM32    EQU    0x51

__IO_APU_OP_SADD    EQU    0x6C
__IO_APU_OP_SSUB    EQU    0x6D
__IO_APU_OP_SMUL    EQU    0x6E
__IO_APU_OP_SMUU    EQU    0x76
__IO_APU_OP_SDIV    EQU    0x6F

__IO_APU_OP_DADD    EQU    0x2C
__IO_APU_OP_DSUB    EQU    0x2D
__IO_APU_OP_DMUL    EQU    0x2E
__IO_APU_OP_DMUU    EQU    0x36
__IO_APU_OP_DDIV    EQU    0x2F

__IO_APU_OP_FADD    EQU    0x10
__IO_APU_OP_FSUB    EQU    0x11
__IO_APU_OP_FMUL    EQU    0x12
__IO_APU_OP_FDIV    EQU    0x13

__IO_APU_OP_SQRT    EQU    0x01
__IO_APU_OP_SIN    EQU    0x02
__IO_APU_OP_COS    EQU    0x03
__IO_APU_OP_TAN    EQU    0x04
__IO_APU_OP_ASIN    EQU    0x05
__IO_APU_OP_ACOS    EQU    0x06
__IO_APU_OP_ATAN    EQU    0x07
__IO_APU_OP_LOG    EQU    0x08
__IO_APU_OP_LN    EQU    0x09
__IO_APU_OP_EXP    EQU    0x0A
__IO_APU_OP_PWR    EQU    0x0B

__IO_APU_OP_NOP    EQU    0x00
__IO_APU_OP_FIXS    EQU    0x1F
__IO_APU_OP_FIXD    EQU    0x1E
__IO_APU_OP_FLTS    EQU    0x1D
__IO_APU_OP_FLTD    EQU    0x1C
__IO_APU_OP_CHSS    EQU    0x74
__IO_APU_OP_CHSD    EQU    0x34
__IO_APU_OP_CHSF    EQU    0x15
__IO_APU_OP_PTOS    EQU    0x77
__IO_APU_OP_PTOD    EQU    0x37
__IO_APU_OP_PTOF    EQU    0x17
__IO_APU_OP_POPS    EQU    0x78
__IO_APU_OP_POPD    EQU    0x38
__IO_APU_OP_POPF    EQU    0x18
__IO_APU_OP_XCHS    EQU    0x79
__IO_APU_OP_XCHD    EQU    0x39
__IO_APU_OP_XCHF    EQU    0x19
__IO_APU_OP_PUPI    EQU    0x1A









PUBLIC __IO_I2C_RX_SIZE
PUBLIC __IO_I2C_TX_SIZE

PUBLIC __IO_I2C1_PORT_MSB
PUBLIC __IO_I2C2_PORT_MSB

PUBLIC __IO_I2C_PORT_STA
PUBLIC __IO_I2C_PORT_IPTR
PUBLIC __IO_I2C_PORT_DAT
PUBLIC __IO_I2C_PORT_IDATA
PUBLIC __IO_I2C_PORT_CON

PUBLIC __IO_I2C_PORT_ICOUNT
PUBLIC __IO_I2C_PORT_IADDR
PUBLIC __IO_I2C_PORT_ISCLL
PUBLIC __IO_I2C_PORT_ISCLH
PUBLIC __IO_I2C_PORT_ITO
PUBLIC __IO_I2C_PORT_IPRESET
PUBLIC __IO_I2C_PORT_IMODE

PUBLIC __IO_I2C_STA_ILLEGAL_START_STOP
PUBLIC __IO_I2C_STA_MASTER_START_TX
PUBLIC __IO_I2C_STA_MASTER_RESTART_TX
PUBLIC __IO_I2C_STA_MASTER_SLA_W_ACK
PUBLIC __IO_I2C_STA_MASTER_SLA_W_NAK
PUBLIC __IO_I2C_STA_MASTER_DATA_W_ACK
PUBLIC __IO_I2C_STA_MASTER_DATA_W_NAK
PUBLIC __IO_I2C_STA_MASTER_ARB_LOST
PUBLIC __IO_I2C_STA_MASTER_SLA_R_ACK
PUBLIC __IO_I2C_STA_MASTER_SLA_R_NAK
PUBLIC __IO_I2C_STA_MASTER_DATA_R_ACK
PUBLIC __IO_I2C_STA_MASTER_DATA_R_NAK
PUBLIC __IO_I2C_STA_SLAVE_AD_W
PUBLIC __IO_I2C_STA_SLAVE_AL_AD_W
PUBLIC __IO_I2C_STA_SDA_STUCK
PUBLIC __IO_I2C_STA_SCL_STUCK
PUBLIC __IO_I2C_STA_SLAVE_DATA_RX_ACK
PUBLIC __IO_I2C_STA_SLAVE_DATA_RX_NAK
PUBLIC __IO_I2C_STA_SLAVE_STOP_OR_RESTART
PUBLIC __IO_I2C_STA_SLAVE_AD_R
PUBLIC __IO_I2C_STA_SLAVE_AL_AD_R
PUBLIC __IO_I2C_STA_SLAVE_DATA_TX_ACK
PUBLIC __IO_I2C_STA_SLAVE_DATA_TX_NAK
PUBLIC __IO_I2C_STA_SLAVE_LST_TX_ACK
PUBLIC __IO_I2C_STA_SLAVE_GC
PUBLIC __IO_I2C_STA_SLAVE_GC_AL
PUBLIC __IO_I2C_STA_SLAVE_GC_RX_ACK
PUBLIC __IO_I2C_STA_SLAVE_GC_RX_NAK
PUBLIC __IO_I2C_STA_IDLE
PUBLIC __IO_I2C_STA_ILLEGAL_ICOUNT

PUBLIC __IO_I2C_CON_AA
PUBLIC __IO_I2C_CON_ENSIO
PUBLIC __IO_I2C_CON_STA
PUBLIC __IO_I2C_CON_STO
PUBLIC __IO_I2C_CON_SI
PUBLIC __IO_I2C_CON_MODE

PUBLIC __IO_I2C_CON_ECHO_BUS_STOPPED
PUBLIC __IO_I2C_CON_ECHO_BUS_RESTART
PUBLIC __IO_I2C_CON_ECHO_BUS_ILLEGAL

PUBLIC __IO_I2C_ICOUNT_LB

PUBLIC __IO_I2C_ITO_TE

PUBLIC __IO_I2C_IMODE_STD
PUBLIC __IO_I2C_IMODE_FAST
PUBLIC __IO_I2C_IMODE_FASTP
PUBLIC __IO_I2C_IMODE_TURBO
PUBLIC __IO_I2C_IMODE_MASK




__IO_I2C_RX_SIZE    EQU    68
__IO_I2C_TX_SIZE    EQU    68

__IO_I2C1_PORT_MSB    EQU    0xa0
__IO_I2C2_PORT_MSB    EQU    0x80

__IO_I2C_PORT_STA    EQU    0x00
__IO_I2C_PORT_IPTR    EQU    0x00
__IO_I2C_PORT_DAT    EQU    0x01
__IO_I2C_PORT_IDATA    EQU    0x02
__IO_I2C_PORT_CON    EQU    0x03

__IO_I2C_PORT_ICOUNT    EQU    0x00
__IO_I2C_PORT_IADDR    EQU    0x01
__IO_I2C_PORT_ISCLL    EQU    0x02
__IO_I2C_PORT_ISCLH    EQU    0x03
__IO_I2C_PORT_ITO    EQU    0x04
__IO_I2C_PORT_IPRESET    EQU    0x05
__IO_I2C_PORT_IMODE    EQU    0x06

__IO_I2C_STA_ILLEGAL_START_STOP    EQU    0x00
__IO_I2C_STA_MASTER_START_TX    EQU    0x08
__IO_I2C_STA_MASTER_RESTART_TX    EQU    0x10
__IO_I2C_STA_MASTER_SLA_W_ACK    EQU    0x18
__IO_I2C_STA_MASTER_SLA_W_NAK    EQU    0x20
__IO_I2C_STA_MASTER_DATA_W_ACK    EQU    0x28
__IO_I2C_STA_MASTER_DATA_W_NAK    EQU    0x30
__IO_I2C_STA_MASTER_ARB_LOST    EQU    0x38
__IO_I2C_STA_MASTER_SLA_R_ACK    EQU    0x40
__IO_I2C_STA_MASTER_SLA_R_NAK    EQU    0x48
__IO_I2C_STA_MASTER_DATA_R_ACK    EQU    0x50
__IO_I2C_STA_MASTER_DATA_R_NAK    EQU    0x58
__IO_I2C_STA_SLAVE_AD_W    EQU    0x60
__IO_I2C_STA_SLAVE_AL_AD_W    EQU    0x68
__IO_I2C_STA_SDA_STUCK    EQU    0x70
__IO_I2C_STA_SCL_STUCK    EQU    0x78
__IO_I2C_STA_SLAVE_DATA_RX_ACK    EQU    0x80
__IO_I2C_STA_SLAVE_DATA_RX_NAK    EQU    0x88
__IO_I2C_STA_SLAVE_STOP_OR_RESTART    EQU    0xA0
__IO_I2C_STA_SLAVE_AD_R    EQU    0xA8
__IO_I2C_STA_SLAVE_AL_AD_R    EQU    0xB0
__IO_I2C_STA_SLAVE_DATA_TX_ACK    EQU    0xB8
__IO_I2C_STA_SLAVE_DATA_TX_NAK    EQU    0xC0
__IO_I2C_STA_SLAVE_LST_TX_ACK    EQU    0xC8
__IO_I2C_STA_SLAVE_GC    EQU    0xD0
__IO_I2C_STA_SLAVE_GC_AL    EQU    0xD8
__IO_I2C_STA_SLAVE_GC_RX_ACK    EQU    0xE0
__IO_I2C_STA_SLAVE_GC_RX_NAK    EQU    0xE8
__IO_I2C_STA_IDLE    EQU    0xF8
__IO_I2C_STA_ILLEGAL_ICOUNT    EQU    0xFC

__IO_I2C_CON_AA    EQU    0x80
__IO_I2C_CON_ENSIO    EQU    0x40
__IO_I2C_CON_STA    EQU    0x20
__IO_I2C_CON_STO    EQU    0x10
__IO_I2C_CON_SI    EQU    0x08
__IO_I2C_CON_MODE    EQU    0x01

__IO_I2C_CON_ECHO_BUS_STOPPED    EQU    0x10
__IO_I2C_CON_ECHO_BUS_RESTART    EQU    0x04
__IO_I2C_CON_ECHO_BUS_ILLEGAL    EQU    0x02

__IO_I2C_ICOUNT_LB    EQU    0x80

__IO_I2C_ITO_TE    EQU    0x80

__IO_I2C_IMODE_STD    EQU    0x00
__IO_I2C_IMODE_FAST    EQU    0x01
__IO_I2C_IMODE_FASTP    EQU    0x02
__IO_I2C_IMODE_TURBO    EQU    0x03
__IO_I2C_IMODE_MASK    EQU    0x03










PUBLIC __IO_PIO_IDE_LSB
PUBLIC __IO_PIO_IDE_MSB
PUBLIC __IO_PIO_IDE_CTL
PUBLIC __IO_PIO_IDE_CONFIG
PUBLIC __IO_PIO_IDE_RD
PUBLIC __IO_PIO_IDE_WR

PUBLIC __IO_IDE_A0_LINE
PUBLIC __IO_IDE_A1_LINE
PUBLIC __IO_IDE_A2_LINE
PUBLIC __IO_IDE_CS0_LINE
PUBLIC __IO_IDE_CS1_LINE
PUBLIC __IO_IDE_WR_LINE
PUBLIC __IO_IDE_RD_LINE
PUBLIC __IO_IDE_RST_LINE

PUBLIC __IO_IDE_DATA
PUBLIC __IO_IDE_ERROR
PUBLIC __IO_IDE_SEC_CNT
PUBLIC __IO_IDE_SECTOR
PUBLIC __IO_IDE_CYL_LSB
PUBLIC __IO_IDE_CYL_MSB
PUBLIC __IO_IDE_HEAD
PUBLIC __IO_IDE_COMMAND
PUBLIC __IO_IDE_STATUS

PUBLIC __IO_IDE_CONTROL
PUBLIC __IO_IDE_ALT_STATUS

PUBLIC __IO_IDE_LBA0
PUBLIC __IO_IDE_LBA1
PUBLIC __IO_IDE_LBA2
PUBLIC __IO_IDE_LBA3

PUBLIC __IDE_CMD_READ
PUBLIC __IDE_CMD_WRITE

PUBLIC __IDE_CMD_STANDBY
PUBLIC __IDE_CMD_IDLE
PUBLIC __IDE_CMD_SLEEP
PUBLIC __IDE_CMD_CACHE_FLUSH
PUBLIC __IDE_CMD_ID




__IO_PIO_IDE_LSB    EQU    0x4000
__IO_PIO_IDE_MSB    EQU    0x4001
__IO_PIO_IDE_CTL    EQU    0x4002
__IO_PIO_IDE_CONFIG    EQU    0x4003
__IO_PIO_IDE_RD    EQU    0x92
__IO_PIO_IDE_WR    EQU    0x80

__IO_IDE_A0_LINE    EQU    0x10
__IO_IDE_A1_LINE    EQU    0x04
__IO_IDE_A2_LINE    EQU    0x40
__IO_IDE_CS0_LINE    EQU    0x08
__IO_IDE_CS1_LINE    EQU    0x20
__IO_IDE_WR_LINE    EQU    0x01
__IO_IDE_RD_LINE    EQU    0x02
__IO_IDE_RST_LINE    EQU    0x80

__IO_IDE_DATA    EQU    0x08
__IO_IDE_ERROR    EQU    0x18
__IO_IDE_SEC_CNT    EQU    0xc
__IO_IDE_SECTOR    EQU    0x1c
__IO_IDE_CYL_LSB    EQU    0x48
__IO_IDE_CYL_MSB    EQU    0x58
__IO_IDE_HEAD    EQU    0x4c
__IO_IDE_COMMAND    EQU    0x5c
__IO_IDE_STATUS    EQU    0x5c

__IO_IDE_CONTROL    EQU    0x64
__IO_IDE_ALT_STATUS    EQU    0x64

__IO_IDE_LBA0    EQU    0x1c
__IO_IDE_LBA1    EQU    0x48
__IO_IDE_LBA2    EQU    0x58
__IO_IDE_LBA3    EQU    0x4c

__IDE_CMD_READ    EQU    0x20
__IDE_CMD_WRITE    EQU    0x30

__IDE_CMD_STANDBY    EQU    0xE0
__IDE_CMD_IDLE    EQU    0xE1
__IDE_CMD_SLEEP    EQU    0xE6
__IDE_CMD_CACHE_FLUSH    EQU    0xE7
__IDE_CMD_ID    EQU    0xEC

END

